## base_external/Config.in
```kconfig
source "$BR2_EXTERNAL_project_base_PATH/package/wheel/Config.in"
source "$BR2_EXTERNAL_project_base_PATH/package/sense-hat/Config.in"
source "$BR2_EXTERNAL_project_base_PATH/package/sense-emu/Config.in"
source "$BR2_EXTERNAL_project_base_PATH/package/pika/Config.in"
source "$BR2_EXTERNAL_project_base_PATH/package/aesd-sensehatlive/Config.in"
source "$BR2_EXTERNAL_project_base_PATH/package/rtimulib/Config.in"
```

## base_external/package/aesd-sensehatlive/Config.in
```kconfig
config BR2_PACKAGE_AESD_SENSEHATLIVE
	bool "aesd-sensehatlive"
	help
	  Sense hat live applicaiton.  This is the producer version of sense hat live.
```

## base_external/package/pika/Config.in
```kconfig
config BR2_PACKAGE_PIKA
	bool "pika"
	help
	  Pika is a pure-Python implementation of the AMQP 0-9-1 protocol including RabbitMQ’s extensions..
```

## base_external/package/rtimulib/Config.in
```kconfig
config BR2_PACKAGE_RTIMULIB
	bool "rtimulib"
	help
	   IMU Sensor Fusion Library.
```

## base_external/package/sense-emu/Config.in
```kconfig
config BR2_PACKAGE_SENSE_EMU
	bool "sense-emu"
	help
	  This package emulates the Raspberry Pi Sense HAT. Inlcudes RTIMU module
```
